/*
 * Corne Xiao v1 keymap, ported from Townk's ZMK configuration
 * (https://github.com/Townk/zmk-config).
 *
 * This keymap has two responsibilities in the shared-layout system:
 *
 * 1. Include the correct key positions definition from the `keypos_def`
 *    directory;
 * 2. Define a macro function called `LAYER_ADAPTER` that takes 60 arguments
 *    (one per key in the logical layout), and maps them onto the keyboard's
 *    42-key physical shape.
 *
 * After this is done, it imports the standard layout file, which creates the
 * keymap using the macro function defined here.
 */

#include "keypos_def/corne_xiao_v1.dtsi"

// Define the layer adapter function for the Corne Xiao v1.
// The logical layout is 60 keys wide (k00..k4B); the adapter drops the HYP/MEH
// columns, the header row, and two extra footer + thumb keys so only the 42
// physical keys remain.
#define LAYER_ADAPTER(                                                    \
    k00, k01, k02, k03, k04, k05,           k06, k07, k08, k09, k0A, k0B, \
    k10, k11, k12, k13, k14, k15, k16, k17, k18, k19, k1A, k1B, k1C, k1D, \
    k20, k21, k22, k23, k24, k25, k26, k27, k28, k29, k2A, k2B, k2C, k2D, \
    k30, k31, k32, k33, k34, k35, k36, k37, k38, k39, k3A, k3B, k3C, k3D, \
         k40, k41, k42, k43, k44, k45, k46, k47, k48, k49, k4A, k4B       \
)                                                                         \
             k10 k11 k12 k13 k14 k15    k18 k19 k1A k1B k1C k1D           \
             k20 k21 k22 k23 k24 k25    k28 k29 k2A k2B k2C k2D           \
             k30 k31 k32 k33 k34 k35    k38 k39 k3A k3B k3C k3D           \
                         k40 k43 k44    k47 k48 k4B

#define COMBO_KEY_CAPS_WORD  <LM1 RM1>

#include "layout/standard_layout.dtsi"
