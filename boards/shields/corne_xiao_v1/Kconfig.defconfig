## boards/shields/corne_xiao_v1/Kconfig.defconfig
```kconfig
if SHIELD_CORNE_XIAO_V1_LEFT

config ZMK_KEYBOARD_NAME
    default "Corne"

config ZMK_SPLIT_ROLE_CENTRAL
    default y

endif

if SHIELD_CORNE_XIAO_V1_LEFT || SHIELD_CORNE_XIAO_V1_RIGHT

config ZMK_SPLIT
    default y

config ZMK_DISPLAY

if ZMK_DISPLAY

config I2C
    default y

config SSD1306
    default y

endif # ZMK_DISPLAY

if LVGL

config LV_Z_VDB_SIZE
    default 64

config LV_DPI_DEF
    default 148

config LV_Z_BITS_PER_PIXEL
    default 1

choice LV_COLOR_DEPTH
    default LV_COLOR_DEPTH_1
endchoice

endif # LVGL

choice ZMK_DISPLAY_STATUS_SCREEN
    default ZMK_DISPLAY_STATUS_SCREEN_BUILT_IN
endchoice

# Experiment: custom screen needs labels + the mono theme (for a font).
config ZMK_DISPLAY_STATUS_SCREEN_CUSTOM
    select LV_USE_LABEL
    select LV_USE_THEME_MONO

endif
```

## boards/shields/corne_xiao_v1/Kconfig.shield
```kconfig
config SHIELD_CORNE_XIAO_V1_LEFT
    def_bool $(shields_list_contains,corne_xiao_v1_left)

config SHIELD_CORNE_XIAO_V1_RIGHT
    def_bool $(shields_list_contains,corne_xiao_v1_right)

config CORNE_XIAO_RIGHT_TRACKPAD
    bool "Enable Cirque GlidePoint trackpad on the right half"
    depends on SHIELD_CORNE_XIAO_V1_RIGHT
    depends on !ZMK_DISPLAY
    help
      Install the Cirque GlidePoint (Pinnacle) trackpad on the right half in
      place of the OLED. Requires the trackpad to be wired to the right-half
      xiao_i2c bus. When off (default), the right-half OLED keeps working.
```

## config/west.yml
```yaml
manifest:
  remotes:
    - name: zmkfirmware
      url-base: https://github.com/zmkfirmware
    - name: caksoylar
      url-base: https://github.com/caksoylar
    - name: dhruvinsh
      url-base: https://github.com/dhruvinsh
    - name: mctechnology17
      url-base: https://github.com/mctechnology17
    - name: breakit
      url-base: https://github.com/breakit
  projects:
    - name: zmk
      remote: zmkfirmware
      revision: main
      import: app/west.yml
    - name: zmk-rgbled-widget
      remote: caksoylar
      revision: main
    - name: zmk-tri-state
      remote: dhruvinsh
      revision: main
      path: modules/zmk-tri-state
    - name: zmk-nice-oled
      remote: breakit
      revision: "4.0"
      path: modules/zmk-nice-oled
    - name: zmk-oled-adapter
      remote: mctechnology17
      revision: main
      path: modules/zmk-oled-adapter
  self:
    path: config
```
