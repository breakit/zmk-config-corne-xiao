/*
 * Special keys and helpers for the shared Corne Xiao v1 layout.
 *
 * The original Townk configuration defined mouse-pointer, backlight, and
 * underglow behavior aliases in this file. The Corne Xiao v1 has no RGB
 * underglow, no keyboard backlight, and no mouse-pointer layer in this port,
 * so those blocks are intentionally omitted. What remains are the modifier,
 * macOS-shortcut, and redefined-key helpers used by the retained layers.
 */

// Hyper Key: Shift + Alt + Control + Command
#define LEFT_HYPER             LS(LA(LC(LGUI)))
#define LHYP                   LEFT_HYPER
#define RIGHT_HYPER            RS(RA(RC(RGUI)))
#define RHYP                   RIGHT_HYPER

// Hyper Key function like LG and RG
#define LH(keycode)            LS(LA(LC(LG(keycode))))
#define RH(keycode)            RS(RA(RC(RG(keycode))))

// Meh Key: Shift + Alt + Control
#define LEFT_MEH               LS(LA(LCTRL))
#define LMEH                   LEFT_MEH
#define RIGHT_MEH              RS(RA(RCTRL))
#define RMEH                   RIGHT_MEH

// Meh Key function like LG and RG
#define LM(keycode)            LS(LA(LC(keycode)))
#define RM(keycode)            RS(RA(RC(keycode)))

// Keys I feel should be part of ZMK
#define BACK_TAB               LS(TAB)
#define BTAB                   BACK_TAB

// Windows keys and common shortcuts.
// These were originally macOS (Cmd/Launchpad/Mission Control/Spotlight) and
// are retargeted to Windows equivalents for the Buttome layer.
#define MAC_LAUNCHPAD          LG(E)             // Win+E: File Explorer
#define MAC_LP                 MAC_LAUNCHPAD
#define MAC_MISSION_CONTROL    LG(TAB)           // Win+Tab: Task View (all windows)
#define MAC_MC                 MAC_MISSION_CONTROL
#define MAC_SPOTLIGHT          LG(S)             // Win+S: Search
#define MAC_SP                 MAC_SPOTLIGHT
#define MAC_CUT                LC(X)
#define MAC_COPY               LC(C)
#define MAC_PASTE              LC(V)
#define MAC_UNDO               LC(Z)
#define MAC_REDO               LC(Y)             // Ctrl+Y: Redo
#define MAC_APP_WINDOWS        LC(TAB)           // Ctrl+Tab: cycle windows in current app
#define MAC_APPWIN             MAC_APP_WINDOWS
#define MAC_NEXT_WINDOW        LC(F6)            // Ctrl+F6: next window in current app
#define MAC_WINN               MAC_NEXT_WINDOW
#define MAC_PREVIOUS_WINDOW    LC(LS(F6))        // Ctrl+Shift+F6: previous window
#define MAC_WINP               MAC_PREVIOUS_WINDOW
#define MAC_NEXT_DESKTOP       LC(LG(RIGHT))     // Ctrl+Win+Right: next virtual desktop
#define MAC_DKTN               MAC_NEXT_DESKTOP
#define MAC_PREVIOUS_DESKTOP   LC(LG(LEFT))      // Ctrl+Win+Left: previous virtual desktop
#define MAC_DKTP               MAC_PREVIOUS_DESKTOP
#define MAC_FIND_NEXT          LC(G)
#define MAC_FDNXT              MAC_FIND_NEXT
#define MAC_FIND_PREVIOUS      LC(LS(G))
#define MAC_FDPRV              MAC_FIND_PREVIOUS
#define MAC_NEXT_WORD          LC(RIGHT)
#define MAC_WRDN               MAC_NEXT_WORD
#define MAC_PREVIOUS_WORD      LC(LEFT)
#define MAC_WRDP               MAC_PREVIOUS_WORD
#define MAC_START_OF_LINE      HOME
#define MAC_STTL               MAC_START_OF_LINE
#define MAC_END_OF_LINE        END
#define MAC_ENDL               MAC_END_OF_LINE

// This helper macro allows one to define a normal key with a special output when
// pressing shift. This is useful when you want to create a key whose shifted
// value differs from the standard behavior.
#define DEFINE_SHIFT_KEY(_behavior_name, _normal_key, _shifted_key) \
    _behavior_name: _behavior_name {                                \
      compatible = "zmk,behavior-mod-morph";                        \
      #binding-cells = <0>;                                         \
      bindings = <_normal_key>, <_shifted_key>;                     \
      mods = <(MOD_LSFT|MOD_RSFT)>;                                 \
    }

#define DEFINE_DOUBLE_TAP_KEY(_behavior_name, _normal_key, _double_tap_key) \
    _behavior_name: _behavior_name {                                        \
      compatible = "zmk,behavior-tap-dance";                                \
      #binding-cells = <0>;                                                 \
      tapping-term-ms = <200>;                                              \
      bindings = <_normal_key>, <_double_tap_key>;                          \
    };

// Internal helper macro to allow us to define all our reversed number keys.
// This macro should NOT be used outside this file!
#define __NUM_REVERSE(_number, _symbol)  DEFINE_SHIFT_KEY(kp_r ## _number, &kp _symbol, &kp _number)

/ {
  behaviors {
    // Make the BACKSPACE key behave like DEL, when holding shift down.
    // This mimics the standard backspace behavior on Mac Books.
    DEFINE_SHIFT_KEY(kp_bspcdel, &kp BACKSPACE, &kp DELETE);

    // The next 10 key behaviors invert the normal number keys. This means that
    // instead of a "number" with tap and a "symbol" with shift-tap, the key
    // will be a "symbol" with tap, and a "number" with a shift-tap. The
    // `__NUM_REVERSE` macro will generate a behavior named `kp_rN<x>`, where
    // `<x>` is the number being reversed:
    __NUM_REVERSE(N1, EXCLAMATION);
    __NUM_REVERSE(N2, AT);
    __NUM_REVERSE(N3, HASH);
    __NUM_REVERSE(N4, DOLLAR);
    __NUM_REVERSE(N5, PERCENT);
    __NUM_REVERSE(N6, CARET);
    __NUM_REVERSE(N7, AMPERSAND);
    __NUM_REVERSE(N8, ASTERISK);
    __NUM_REVERSE(N9, LEFT_PARENTHESIS);
    __NUM_REVERSE(N0, RIGHT_PARENTHESIS);
  };
};
